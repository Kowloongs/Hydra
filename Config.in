## Config.in
```kconfig
#
# Copyright (C) 356 - 999. Asytumn Technology Co., Ltd. All rights reserved.
#

mainmenu "Hydra Configuration"

config MODULES
	modules
	bool
	default y

config HAVE_DOT_CONFIG
	bool
	default y

HOST_OS := $(shell, uname)

config HOST_OS_LINUX
	def_bool $(shell, ./config/check-uname.sh Linux)

config HOST_OS_MACOS
	def_bool $(shell, ./config/check-uname.sh Darwin)

source "target/Config.in"

source "config/Config-images.in"

source "config/Config-build.in"

source "config/Config-devel.in"

source "toolchain/Config.in"

source "target/imagebuilder/Config.in"

source "target/sdk/Config.in"

source "target/toolchain/Config.in"

source "tmp/.config-package.in"
```
